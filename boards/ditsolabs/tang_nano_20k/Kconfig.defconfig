## boards/ditsolabs/tang_nano_20k/Kconfig.defconfig
```kconfig
# Copyright (c) 2025 Ditso Labs <https://ditso-labs.github.io>
# SPDX-License-Identifier: Apache-2.0

if BOARD_TANGNANO20K

if NETWORKING

config NET_L2_ETHERNET
	default y

endif # NETWORKING

endif # BOARD_TANGNANO20K
```

## boards/ditsolabs/tang_nano_20k/board.yml
```yaml
board:
  name: tang_nano_20k
  full_name: Sipeed Tang Nano 20K 
  vendor: ditsolabs
  socs:
  - name: riscv-generic
```

## boards/ditsolabs/tang_nano_20k/tang_nano_20k_defconfig
```kconfig
#
# Copyright (c) 2024 Ditso Labs
#
# SPDX-License-Identifier: Apache-2.0
#

# Basic system configuration
CONFIG_SOC_LITEX_VEXRISCV=y

# Console and UART
CONFIG_CONSOLE=y
CONFIG_SERIAL=y
CONFIG_UART_CONSOLE=y

# GPIO support
CONFIG_GPIO=y

# Memory configuration
CONFIG_SRAM_BASE_ADDRESS=0x40000000
CONFIG_SRAM_SIZE=8388608
CONFIG_HEAP_MEM_POOL_SIZE=4096

# Clock configuration  
CONFIG_SYS_CLOCK_HW_CYCLES_PER_SEC=48000000
CONFIG_SYS_CLOCK_EXISTS=y

# Basic kernel features
CONFIG_PRINTK=y
```

## boards/tang_nano_20k/Kconfig.tang_nano_20k
```kconfig
#
# Copyright (c) 2024 Ditso Labs
#
# SPDX-License-Identifier: Apache-2.0
#

config BOARD_TANG_NANO_20K
	select SOC_LITEX_VEXRISCV
```

## boards/tang_nano_20k/tang_nano_20k_defconfig
```kconfig
#
# Copyright (c) 2019 Antmicro <www.antmicro.com>
#
# SPDX-License-Identifier: Apache-2.0
#

CONFIG_CONSOLE=y
CONFIG_SERIAL=y
CONFIG_UART_CONSOLE=y
CONFIG_GPIO=y
CONFIG_XIP=n
CONFIG_CLOCK_CONTROL=y
CONFIG_HEAP_MEM_POOL_SIZE=4096
CONFIG_SPI_NOR_SFDP_RUNTIME=y
CONFIG_PRINTK=y
CONFIG_SYS_CLOCK_HW_CYCLES_PER_SEC=27000000
CONFIG_SYS_CLOCK_EXISTS=y
CONFIG_SRAM_BASE_ADDRESS=0x40000000
CONFIG_SRAM_SIZE=8192


# Desactiva funciones no soportadas por el SoC
CONFIG_TIMESLICING=n
CONFIG_TICKLESS_KERNEL=n
CONFIG_TIMESLICING=n
CONFIG_TIMEOUT_64BIT=n
CONFIG_SYS_CLOCK_EXISTS=n   # si tu plataforma no lo implementa
```

## soc/litex/Kconfig
```kconfig
# Copyright (c) 2024 Ditso Labs
# SPDX-License-Identifier: Apache-2.0

config SOC_LITEX_VEXRISCV
	bool "LiteX VexRiscV SoC"
	select RISCV
	select ATOMIC_OPERATIONS_C
	help
	  Enable support for LiteX VexRiscV SoC
```

## soc/litex/Kconfig.defconfig
```kconfig
# Copyright (c) 2024 Ditso Labs
# SPDX-License-Identifier: Apache-2.0

if SOC_LITEX_VEXRISCV

config SOC
	default "litex_vexriscv"

config NUM_IRQS
	default 32

endif # SOC_LITEX_VEXRISCV
```
